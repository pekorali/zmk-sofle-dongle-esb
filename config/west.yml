## config/west.yml
```yaml
manifest:
  remotes:
    - name: zmkfirmware
      url-base: https://github.com/zmkfirmware
    - name: gpeye
      url-base: https://github.com/GPeye
    - name: tokyo2006
      url-base: https://github.com/tokyo2006
    - name: englmaxi
      url-base: https://github.com/englmaxi
    - name: kumbung01
      url-base: https://github.com/kumbung01
    - name: badjeff
      url-base: https://github.com/badjeff
    - name: nrfconnect
      url-base: https://github.com/nrfconnect
    - name: mwlaboratories
      url-base: https://github.com/mwlaboratories      
  projects:
    #- name: mario-peripheral-animation
    #  remote: gpeye
    #  revision: main 
    #- name: zmk-behivior-custom-caps-word
    #  remote: kumbung01
    #  revision: main
    - name: zmk
      remote: zmkfirmware
      revision: v0.3
      import: app/west.yml
    - name: prospector-zmk-module                 # <--- and these
      remote: tokyo2006                          # <---
      revision: micro_spi2  
    - name: zmk-dongle-display
      # remote: englmaxi
      remote: kumbung01
      revision: main
    - name: zmk-feature-split-esb
      # remote: badjeff
      remote: kumbung01
      revision: tdma
    - name: sdk-nrf
      remote: nrfconnect
      revision: v2.6.4 # zephyr v3.5.99
      path: nrf
    - name: nrfxlib
      remote: nrfconnect
      revision: v2.6.4
      repo-path: sdk-nrfxlib
      path: nrfxlib
    - name: kb_zmk_ps2_mouse_trackpoint_driver
      remote: mwlaboratories
      revision: main
  self:

    path: config
```
